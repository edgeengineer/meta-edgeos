## meta-edgeos/conf/distro/edgeos.conf
```bitbake
require conf/distro/poky.conf
require systemd.conf

DISTRO = "edgeos"
DISTROOVERRIDES = "poky"

DISTRO_NAME = "edgeOS Linux platform"
DISTRO_VERSION = "v0.1.0"
# DISTRO_CODENAME = "..."

SDK_VENDOR = "-edgeossdk"
SDK_VERSION = "${@d.getVar('DISTRO_VERSION')}"

# MAINTAINER = "name <email>"

# remove distro unnecessary feature(s)
DISTRO_FEATURES:remove = "x11 wayland opengl opengles egl sysvinit ptest 3g"

# Add wifi support for connman
DISTRO_FEATURES:append = " wifi"

# Add virtualization support when container runtime is enabled
DISTRO_FEATURES:append = "${@' virtualization' if d.getVar('EDGEOS_CONTAINER_RUNTIME') == '1' else ''}"
```

## meta-edgeos/conf/layer.conf
```bitbake
BBPATH .= ":${LAYERDIR}"
BBFILES += "${LAYERDIR}/recipes-*/*/*.bb ${LAYERDIR}/recipes-*/*/*.bbappend"

# Dynamic layer support for optional features
BBFILES_DYNAMIC += " \
    meta-mender:${LAYERDIR}/dynamic-layers/meta-mender/recipes-*/*/*.bb \
    meta-mender:${LAYERDIR}/dynamic-layers/meta-mender/recipes-*/*/*.bbappend \
"

BBFILE_COLLECTIONS += "edgeos"
BBFILE_PATTERN_edgeos := "^${LAYERDIR}/"
BBFILE_PRIORITY_edgeos = "6"

IMAGE_FSTYPES += "wic"
WKS_FILE = "rpi-partuuid.wks"
LAYERSERIES_COMPAT_edgeos = "scarthgap"
WKS_SEARCH_PATH:prepend := "${LAYERDIR}/wic:"

EDGE_BOOT_PARTUUID ?= "00000000-0000-0000-0000-000000000000"
EDGE_ROOT_PARTUUID ?= "00000000-0000-0000-0000-000000000000"
```
